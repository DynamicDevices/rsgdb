## CMakeLists.txt
```
# SPDX-License-Identifier: Apache-2.0
# Minimal Zephyr app for rsgdb E2E (native_sim). Built with:
#   west build -b native_sim/native/64 -s /path/to/zephyr_multi_printf_app

cmake_minimum_required(VERSION 3.20.0)
find_package(Zephyr REQUIRED HINTS $ENV{ZEPHYR_BASE})
project(multi_printf_rsgdb)

target_sources(app PRIVATE src/main.c)
```

## prj.conf
```kconfig
# Intentionally minimal; native_sim picks up console + libc for printf.
```

## src/main.c
```c
/*
 * SPDX-License-Identifier: Apache-2.0
 * rsgdb E2E: multiple printf lines — GDB breaks on first, steps over the next.
 */
#include <stdio.h>

int main(void)
{
	printf("RSGDB_E2E line 1\n");
	printf("RSGDB_E2E line 2\n");
	printf("RSGDB_E2E line 3\n");
	return 0;
}
```
